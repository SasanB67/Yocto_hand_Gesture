## build/conf/bblayers.conf
```bitbake
# POKY_BBLAYERS_CONF_VERSION is increased each time build/conf/bblayers.conf
# changes incompatibly
POKY_BBLAYERS_CONF_VERSION = "2"

BBPATH = "${TOPDIR}"
BBFILES ?= ""

BBLAYERS ?= " \
  /home/sasy/Desktop/camTensor/poky/meta \
  /home/sasy/Desktop/camTensor/poky/meta-poky \
  /home/sasy/Desktop/camTensor/poky/meta-yocto-bsp \
  /home/sasy/Desktop/camTensor/meta-openembedded/meta-oe \
  /home/sasy/Desktop/camTensor/meta-openembedded/meta-python \
  /home/sasy/Desktop/camTensor/meta-openembedded/meta-multimedia \
  /home/sasy/Desktop/camTensor/meta-raspberrypi \
  /home/sasy/Desktop/camTensor/meta-tensorflow-lite \
  /home/sasy/Desktop/camTensor/meta-gesture \
  "
```

## meta-gesture/conf/layer.conf
```bitbake
BBPATH .= ":${LAYERDIR}"
BBFILES += "${LAYERDIR}/recipes-*/*/*.bb"

BBFILE_COLLECTIONS += "meta-gesture"
BBFILE_PATTERN_meta-gesture = "^${LAYERDIR}/"
BBFILE_PRIORITY_meta-gesture = "10"

LAYERDEPENDS_meta-gesture = "core meta-tensorflow-lite raspberrypi multimedia-layer"
LAYERSERIES_COMPAT_meta-gesture = "scarthgap"
```
